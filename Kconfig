## Kconfig.packages
```kconfig
menu "Unit_Test_Packages"

config UT_PACKAGES
    bool "Global switch for unit test packages from ZTest build extension"
    default y

if UT_PACKAGES

config UT_RING_BUFFER
	bool "Include the module zephyr/lib/utils/ring_buffer"
    select RING_BUFFER
	default n

config UT_LOGGING
	bool "Include the module zephyr/subsys/logging"
    select LOG
	default n

config UT_MALLOC
	bool "Include the implementation of k_malloc and k_free with std malloc and free"
	default n

config UT_CRC
	bool "Include the module zephyr/lib/crc"
	default n

endif # UT_PACKAGES

endmenu
```

## boards/ztest-build-ext/unit_testing_ext/Kconfig.unit_testing_ext
```kconfig
# SPDX-License-Identifier: Apache-2.0
#
# Copyright (c) 2022 Nordic Semiconductor

config BOARD_UNIT_TESTING_EXT
	bool "Unit testing extension board"
	select HAS_COVERAGE_SUPPORT
	#select CONFIG_NATIVE_LIBRARY
	help
	  Board for unit testing
```

## boards/ztest-build-ext/unit_testing_ext/board.yml
```yaml
board:
  name: unit_testing_ext
  vendor: ztest-build-ext
  socs:
  - name: unit_testing
```

## tests/01-minimal_it_ext/testcase.yaml
```yaml
tests:
  ztest_build_ext.minimal_build: 
    tags:
      - minimal_build
    platform_allow:
      - native_sim
```

## tests/01-minimal_ut_def/testcase.yaml
```yaml
tests:
  ztest_build_ext.minimal_build:
    type: unit
    tags:
      - minimal_build
```

## tests/02-logging_unit_ext/testcase.yaml
```yaml
tests:
  ztest_build_ext.logging: 
    tags:
      - logging_sample
    platform_allow:
      - unit_testing_ext
```

## tests/03-malloc_ut_ext/testcase.yaml
```yaml
tests:
  ztest_build_ext.logging: 
    tags:
      - dummy_malloc
    platform_allow:
      - unit_testing_ext
```

## tests/04-crc_it_ext/testcase.yaml
```yaml
tests:
  utilities.crc:
    tags:
      - crc
    #type: unit
    platform_allow: native_sim/native
  utilities.crc.table256:
    tags:
      - crc
    #type: unit
    platform_allow: native_sim/native
    extra_configs:
      - CONFIG_CRC32_K_4_2_TABLE_256=y
```

## tests/04-crc_ut_ext/testcase.yaml
```yaml
tests:
  utilities.crc:
    tags:
      - crc
    #type: unit
    platform_allow: unit_testing_ext
  utilities.crc.table256:
    tags:
      - crc
    #type: unit
    platform_allow: unit_testing_ext
    extra_configs:
      - CONFIG_CRC32_K_4_2_TABLE_256=y
```

## tests/05-interpolation_it_def/testcase.yaml
```yaml
# Copyright (c) 2024 Embeint Inc
# SPDX-License-Identifier: Apache-2.0

tests:
  utilities.math.interpolation:
    integration_platforms:
      - native_sim
    platform_allow: native_sim
```

## tests/05-interpolation_ut_ext/testcase.yaml
```yaml
# Copyright (c) 2024 Embeint Inc
# SPDX-License-Identifier: Apache-2.0

tests:
  utilities.math.interpolation:
    platform_allow: unit_testing_ext
```
